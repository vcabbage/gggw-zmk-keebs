## config/west.yml
```yaml
manifest:
  defaults:
    revision: main
  remotes:
    - name: zmkfirmware
      url-base: https://github.com/zmkfirmware
    - name: efogdev
      url-base: https://github.com/efogdev
    - name: badjeff
      url-base: https://github.com/badjeff
    - name: caksoylar
      url-base: https://github.com/caksoylar
  projects:
    - name: zmk
      remote: zmkfirmware
      revision: 9ebbeff0a8b69a42f14aec022cdf16c7a107b9e0
      import: app/west.yml
    - name: zmk-pmw3610-driver-badjeff
      remote: badjeff
      repo-path: zmk-pmw3610-driver
      revision: zmk-0.4
      path: modules/zmk-pmw3610-driver-badjeff
    - name: zmk-pmw3610-driver-efog
      remote: efogdev
      repo-path: zmk-pmw3610-driver
      revision: zephyr-4.1
      path: modules/zmk-pmw3610-driver-efog
    - name: zmk-report-rate-limit
      remote: efogdev
      revision: 7f55412be4f85069b67d5984ab7c71aa2a6cf34f
    - name: zmk-input-processor-xyz
      remote: badjeff
      revision: main
    - name: zmk-rgbled-widget
      remote: caksoylar
      revision: e6b467792a1dabef8cfa5c9fd26bfefc9c16662b
  self:
    path: config
```
